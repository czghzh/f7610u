## kernel/f7610u-bringup.its
```
/dts-v1/;

/ {
	description = "F7610U D1: kernel load 0x8C000000, U-Boot PP area reserved";
	#address-cells = <2>;

	images {
		kernel-1 {
			description = "F7610U kernel+initramfs (UART fixed)";
			data = /incbin/("arch/arm64/boot/Image");
			type = "kernel";
			arch = "arm64";
			os = "linux";
			compression = "none";
			load = <0x0 0x8C000000>;
			entry = <0x0 0x8C000000>;
			hash-1 {
				algo = "sha1";
			};
		};

		fdt-1 {
			description = "F7610U dtb (UART fixed)";
			data = /incbin/("arch/arm64/boot/dts/zte/zx279131-f7610u.dtb");
			type = "flat_dt";
			arch = "arm64";
			compression = "none";
			hash-1 {
				algo = "sha1";
			};
		};
	};

	configurations {
		default = "config-1";

		config-1 {
			description = "F7610U console bring-up";
			kernel = "kernel-1";
			fdt = "fdt-1";
		};
	};
};
```

## kernel/f7610u-nand.its
```
/dts-v1/;

/ {
	description = "F7610U NAND bring-up v1 (spifc trial)";
	#address-cells = <2>;

	images {
		kernel-1 {
			description = "F7610U kernel+initramfs (spifc trial)";
			data = /incbin/("arch/arm64/boot/Image");
			type = "kernel";
			arch = "arm64";
			os = "linux";
			compression = "none";
			load = <0x0 0x80200000>;
			entry = <0x0 0x80200000>;
			hash-1 {
				algo = "sha1";
			};
		};

		fdt-1 {
			description = "F7610U dtb (spifc trial)";
			data = /incbin/("arch/arm64/boot/dts/zte/zx279131-f7610u.dtb");
			type = "flat_dt";
			arch = "arm64";
			compression = "none";
			hash-1 {
				algo = "sha1";
			};
		};
	};

	configurations {
		default = "config-1";

		config-1 {
			description = "F7610U NAND bring-up";
			kernel = "kernel-1";
			fdt = "fdt-1";
		};
	};
};
```
